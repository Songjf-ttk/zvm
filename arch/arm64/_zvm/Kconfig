## arch/arm64/_zvm/Kconfig
```kconfig
# Copyright 2021-2022 HNU

# SPDX-License-Identifier: Apache-2.0

# ARM64 _zvm configuration options
config ZVM_SYNC_DESC_INIT_PRIORITY
	int "ZVM sync desc init priority"
	default	70
	help
		ZVM sync desc module initialization priority.
```

## boards/arm64/fvp_cortex_a55/Kconfig.board
```kconfig
# Copyright (c) 2021 Carlo Caione <ccaione@baylibre.com>
# SPDX-License-Identifier: Apache-2.0

config BOARD_FVP_CORTEX_A55
	bool "FVP Cortex A55x4 AEMv8A simulation board"
	depends on SOC_FVP_CORTEX_A55
```

## boards/arm64/fvp_cortex_a55/Kconfig.defconfig
```kconfig
# Copyright (c) 2021 Carlo Caione <ccaione@baylibre.com>
# SPDX-License-Identifier: Apache-2.0

if BOARD_FVP_CORTEX_A55

config BUILD_OUTPUT_BIN
	default y

config BOARD
	default "fvp_cortex_a55"

endif # BOARD_FVP_CORTEX_A55
```

## boards/arm64/fvp_cortex_a55x4_a75x2_smp/Kconfig.board
```kconfig
# Copyright (c) 2021 Carlo Caione <ccaione@baylibre.com>
# SPDX-License-Identifier: Apache-2.0

config BOARD_FVP_CORTEX_A55x4_A75x2_SMP
	bool "FVP Cortex A55x4_A75x2_smp simulation board"
	depends on SOC_FVP_BASE_A55X4_A75X2
```

## boards/arm64/fvp_cortex_a55x4_a75x2_smp/Kconfig.defconfig
```kconfig
# Copyright (c) 2021 Carlo Caione <ccaione@baylibre.com>
# SPDX-License-Identifier: Apache-2.0

if BOARD_FVP_CORTEX_A55x4_A75x2_SMP

config BUILD_OUTPUT_BIN
	default y

config BOARD
	default "fvp_cortex_a55x4_a75x2_smp"

endif # BOARD_FVP_CORTEX_A55x4_A75x2_SMP
```

## boards/arm64/fvp_cortex_a55x4_a75x2_smp/fvp_cortex_a55x4_a75x2_smp_defconfig
```kconfig
# Copyright (c) 2021 Carlo Caione <ccaione@baylibre.com>
# SPDX-License-Identifier: Apache-2.0

CONFIG_SOC_SERIES_FVP_BASE_AARCH64=y
CONFIG_SOC_FVP_BASE_A55X4_A75X2=y
CONFIG_BOARD_FVP_CORTEX_A55x4_A75x2_SMP=y

CONFIG_XIP=n

CONFIG_IDLE_STACK_SIZE=8192
CONFIG_ISR_STACK_SIZE=8192
CONFIG_MAIN_STACK_SIZE=8192
CONFIG_SHELL_STACK_SIZE=32768
CONFIG_THREAD_STACK_INFO=y

# Enable Timer and Sys clock
CONFIG_SYS_CLOCK_TICKS_PER_SEC=1000
CONFIG_ARM_ARCH_TIMER=y

# Enable UART driver
CONFIG_SERIAL=y

# Enable serial port
CONFIG_UART_PL011=y
CONFIG_UART_PL011_PORT0=y

# Enable console
CONFIG_CONSOLE=y
CONFIG_UART_CONSOLE=y


# make more table for host's pgd
CONFIG_MAX_XLAT_TABLES=16
# make more table for vm's pgd
CONFIG_ZVM_MAX_XLAT_TABLES=128

#enable
CONFIG_SMP=y
CONFIG_CACHE_MANAGEMENT=y

CONFIG_PM_CPU_OPS=y
CONFIG_PM_CPU_OPS_PSCI=n
```

## boards/arm64/qemu_cortex_max/Kconfig.board
```kconfig
# Copyright (c) 2019 Carlo Caione <ccaione@baylibre.com>
# Copyright 2021-2022 HNU
# SPDX-License-Identifier: Apache-2.0

config BOARD_QEMU_CORTEX_MAX
	bool "Cortex-Max Emulation (QEMU)"
	depends on SOC_QEMU_CORTEX_MAX
	select ARM64
	select QEMU_TARGET
```

## boards/arm64/qemu_cortex_max/Kconfig.defconfig
```kconfig
# Copyright (c) 2019 Carlo Caione <ccaione@baylibre.com>
# Copyright 2021-2022 HNU
# SPDX-License-Identifier: Apache-2.0

if BOARD_QEMU_CORTEX_MAX

config BUILD_OUTPUT_BIN
	default y

config BOARD
	default "qemu_cortex_max"

endif # BOARD_QEMU_CORTEX_MAX
```

## boards/arm64/qemu_cortex_max/qemu_cortex_max_smp_defconfig
```kconfig
# Copyright 2021-2022 HNU
# SPDX-License-Identifier: Apache-2.0

# Basic board infomation
CONFIG_SOC_QEMU_CORTEX_MAX=y
CONFIG_BOARD_QEMU_CORTEX_MAX=y
CONFIG_QEMU_ICOUNT=n

# SMP support
CONFIG_SMP=y
CONFIG_ARMV8_A_NS=y
CONFIG_MP_NUM_CPUS=4
CONFIG_CACHE_MANAGEMENT=y
CONFIG_TIMEOUT_64BIT=y

# PSCI is supported
CONFIG_PM_CPU_OPS=y
CONFIG_PM_CPU_OPS_PSCI=y

# Enable Timer and Sys clock
CONFIG_SYS_CLOCK_TICKS_PER_SEC=1000
CONFIG_ARM_ARCH_TIMER=y

# Enable serial port
CONFIG_SERIAL=y
CONFIG_UART_PL011=y
CONFIG_UART_PL011_PORT0=y
#CONFIG_UART_PL011_PORT1=y
CONFIG_UART_INTERRUPT_DRIVEN=y
```

## boards/arm64/roc_rk3568_pc/Kconfig.board
```kconfig
# Copyright 2022 HNU-ESNL
# Copyright 2022 openEuler SIG-Zephyr
# SPDX-License-Identifier: Apache-2.0

config BOARD_ROC_RK3568_PC
	bool "Rockchip ROC-RK3568-PC"
	depends on SOC_SERIES_RK3568
	select ARM64

#ifdef BOARD_ROC_RK3568_PC

config RK3568_CLOCK_CONTROL_INIT_PRIORITY
	int "Clock control init priority"
	help
	  Clock control driver device initialization priority for rk3568.

#endif
```

## boards/arm64/roc_rk3568_pc/Kconfig.defconfig
```kconfig
# Copyright 2020 HNU
# SPDX-License-Identifier: Apache-2.0

if BOARD_ROC_RK3568_PC

config BOARD
	default "roc_rk3568_pc"

endif # BOARD_ROC_RK3568_PC
```

## boards/arm64/roc_rk3568_pc/roc_rk3568_pc_defconfig
```kconfig
# SPDX-License-Identifier: Apache-2.0

# Platform Configuration
CONFIG_SOC_SERIES_RK3568=y
CONFIG_SOC_RK3568=y
CONFIG_BOARD_ROC_RK3568_PC=y

# SMP support
CONFIG_SMP=n
CONFIG_ARMV8_A_NS=y
CONFIG_MP_NUM_CPUS=1
CONFIG_TIMEOUT_64BIT=y
CONFIG_CACHE_MANAGEMENT=y

# PSCI is supported
CONFIG_PM=y
CONFIG_PM_CPU_OPS=y
CONFIG_PM_CPU_OPS_PSCI=y

# Enable Timer and Sys clock
CONFIG_ARM_ARCH_TIMER=y
CONFIG_CLOCK_CONTROL=y

# Serial Drivers
CONFIG_SERIAL=y
CONFIG_UART_NS16550=y
CONFIG_UART_INTERRUPT_DRIVEN=y
CONFIG_NS16650_EARLYPRINT_DEBUG=n

# Enable console
CONFIG_CONSOLE=y
CONFIG_UART_CONSOLE=y

# Threads stacks
CONFIG_ISR_STACK_SIZE=16384
CONFIG_IDLE_STACK_SIZE=8192
CONFIG_MAIN_STACK_SIZE=8192
CONFIG_SHELL_STACK_SIZE=65536
CONFIG_THREAD_STACK_INFO=y

# make more table for host's pgd
CONFIG_MAX_XLAT_TABLES=16
```

## boards/arm64/roc_rk3568_pc/roc_rk3568_pc_smp_defconfig
```kconfig
# SPDX-License-Identifier: Apache-2.0

# Platform Configuration
CONFIG_SOC_SERIES_RK3568=y
CONFIG_SOC_RK3568=y
CONFIG_BOARD_ROC_RK3568_PC=y

# SMP support
CONFIG_SMP=y
CONFIG_ARMV8_A_NS=y
CONFIG_MP_NUM_CPUS=4
CONFIG_TIMEOUT_64BIT=y
CONFIG_CACHE_MANAGEMENT=y

# PSCI is supported
CONFIG_PM=y
CONFIG_PM_CPU_OPS=y
CONFIG_PM_CPU_OPS_PSCI=y

# Enable Timer and Sys clock
CONFIG_ARM_ARCH_TIMER=y
CONFIG_CLOCK_CONTROL=y

# Serial Drivers
CONFIG_SERIAL=y
CONFIG_UART_NS16550=y
CONFIG_UART_INTERRUPT_DRIVEN=y
CONFIG_NS16550_EARLYPRINT_DEBUG=n
CONFIG_NS16550_ASM_PRINTK=n

# Enable console
CONFIG_CONSOLE=y
CONFIG_UART_CONSOLE=y

CONFIG_KERNEL_VM_SIZE=0x3200000

# System control register
CONFIG_SYSCON=y

# clock controller
CONFIG_CLOCK_CONTROL_RK3568=y
```

## drivers/clock_control/Kconfig.rk3568_cru
```kconfig
# MCUXpresso SDK CRU

# Copyright (c) 2017, HNU
# SPDX-License-Identifier: Apache-2.0

config CLOCK_CONTROL_RK3568_CRU
	bool "RK3568 CRU driver"
	help
	  Enable support for rk3568 cru driver.
```

## dts/bindings/clock/rockchip,rk3568-cru.yaml
```yaml
# Copyright (c) 2022, NXP
# SPDX-License-Identifier: Apache-2.0


description: |
  The RK3568 clock controller generates the clock and also implements a
  reset controller for SoC peripherals.
  (examples: provide SCLK_UART1\PCLK_UART1 and SRST_P_UART1\SRST_S_UART1 for UART module)

compatible: "rockchip,rk3568-cru"

include: [clock-controller.yaml, base.yaml]

properties:
  reg:
    required: true

  "#clock-cells":
    const: 1

  "#reset-cells":
    type: int
    const: 1
    required: true

clock-cells:
  - name
```

## dts/bindings/cpu/arm,cortex-a55.yaml
```yaml
# Copyright (c) 2022 Carlo Caione <ccaione@baylibre.com>
# SPDX-License-Identifier: Apache-2.0

description: This is a representation of ARM Cortex-A55 CPU.

compatible: "arm,cortex-a55"

include: cpu.yaml
```

## dts/bindings/cpu/cpu.yaml
```yaml
# Copyright (c) 2019 Nordic Semiconductor ASA
# SPDX-License-Identifier: Apache-2.0

# Common fields for CPUs

include: base.yaml

properties:
    clock-frequency:
      type: int
      required: false
      description: Clock frequency in Hz
    cpu-power-states:
       type: phandles
       required: false
       description: List of power management states supported by this cpu
    i-cache-line-size:
      type: int
      required: false
      description: i-cache line size
    d-cache-line-size:
      type: int
      required: false
      description: d-cache line size
    enable-method:
      type: string
      required: false
      description: Enable method for cpu, either it is "psci" or "spin-table"
```

## soc/arm64/arm/fvp_base_aarch64/Kconfig.series
```kconfig
# Copyright (c) 2021 Carlo Caione <ccaione@baylibre.com>
# SPDX-License-Identifier: Apache-2.0

config SOC_SERIES_FVP_BASE_AARCH64
	bool "ARM FVP Base AArch64 Series"
	select ARM64
	select SOC_FAMILY_ARM64
	help
	  Enable support for ARM FVP Base_AArch64 Series
```

## soc/arm64/arm/fvp_base_aarch64/Kconfig.soc
```kconfig
# Copyright (c) 2021 Carlo Caione <ccaione@baylibre.com>
# SPDX-License-Identifier: Apache-2.0

choice
	prompt "ARM FVP Base_A55x4_A75x2 SoCs"
	depends on SOC_SERIES_FVP_BASE_AARCH64

config SOC_FVP_BASE_A55X4_A75X2
	bool "ARM FVP Base A55x4 A75x2 AArch64 simulation"
	select CPU_CORTEX_A55
	select GIC_V3

endchoice
```

## soc/arm64/qemu_cortex_max/Kconfig.soc
```kconfig
# Copyright (c) 2019 Carlo Caione <ccaione@baylibre.com>
# SPDX-License-Identifier: Apache-2.0

config SOC_QEMU_CORTEX_MAX
	bool "QEMU virt platform (cortex-max)"
	select ARM64
	select CPU_CORTEX_MAX
	select GIC_V3
```

## soc/arm64/rockchip/Kconfig
```kconfig
# Copyright (c) 2017-2022, HNU
# SPDX-License-Identifier: Apache-2.0

config SOC_FAMILY_RK3500
	bool
	select HAS_SEGGER_RTT

if SOC_FAMILY_RK3500

config SOC_FAMILY
	string
	default "rockchip"

source "soc/arm64/rockchip/*/Kconfig.soc"

endif # SOC_FAMILY_RK3500
```

## soc/arm64/rockchip/Kconfig.soc
```kconfig
# Copyright (c) 2022, HNU
# SPDX-License-Identifier: Apache-2.0

source "soc/arm64/rockchip/*/Kconfig.series"
```

## soc/arm64/rockchip/rk3568/Kconfig.series
```kconfig
# Copyright 2022 HNU
# SPDX-License-Identifier: Apache-2.0

config SOC_SERIES_RK3568
	bool "Rockchip RK3568 Series"
	select ARM64
	select SOC_FAMILY_ROCKCHIP
	help
	  Enable support for RK3568 Series.
```

## soc/arm64/rockchip/rk3568/Kconfig.soc
```kconfig
# Copyright 2022 HNU
# SPDX-License-Identifier: Apache-2.0

choice
prompt "Rockchip RK3568 SoC"
depends on SOC_SERIES_RK3568

config SOC_RK3568
	bool "Rockchip rk3568"
	select ARM64
	select CPU_CORTEX_A55
	select ARM_ARCH_TIMER
	select GIC_V3
	select CLOCK_CONTROL_RK3568_CRU
	select HAS_ARM_VHE_EXTN

endchoice
```

## soc/arm64/rockchip/rk356x/Kconfig.defconfig.series
```kconfig
# Copyright 2022 HNU
# SPDX-License-Identifier: Apache-2.0

if SOC_SERIES_RK356X

config SOC_SERIES
	default "rk356x"

source "soc/arm64/rockchip/rk356x/Kconfig.defconfig.rk356*"

endif # SOC_SERIES_RK356X
```
