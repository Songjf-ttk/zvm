## soc/arm64/rockchip/rk356x/Kconfig.series
```kconfig
# Copyright 2022 HNU
# SPDX-License-Identifier: Apache-2.0

config SOC_SERIES_RK356X
	bool "Rockchip RK356X Series"
	select ARM64
	select SOC_FAMILY_RK3500
	help
	  Enable support for RK356X Series.
```

## soc/arm64/rockchip/rk356x/Kconfig.soc
```kconfig
# Copyright 2022 HNU
# SPDX-License-Identifier: Apache-2.0

choice
prompt "Rockchip RK3568 Selection"
depends on SOC_SERIES_RK356X

config SOC_RK3568
	bool "Rockchip rk3568"
	select ARM64
	select CPU_CORTEX_A55
	select ARM_ARCH_TIMER
	select GIC_V3
	select CLOCK_CONTROL_RK3568_CRU
	select HAS_ARM_VHE_EXTN

endchoice


if SOC_RK3568

config SOC_PART_NUMBER_ROCRK3568PC
	bool

config SOC_PART_NUMBER
	string
	default "RK3568" if SOC_PART_NUMBER_ROCRK3568PC
	help
	  This string holds the full part number of the SoC. It is a hidden option
	  that you should not set directly. The part number selection choice defines
	  the default value for this string.

endif
```

## subsys/virtualization/Kconfig
```kconfig
# Copyright 2021-2022 HNU
# SPDX-License-Identifier: Apache-2.0

source "subsys/virtualization/vdev/Kconfig"

menuconfig ZVM
	bool "Zephyr Based Virtualization menu"
	default n
	# Need USERSPACE memory manager
	select USERSPACE
	help
	  Zephyr virtualization support.

if ZVM

config MAX_VM_NUM
	int "Maximum number of simultaneous VMs"
	range 0 32
	default 2
	help
	  Maximum number of simultaneous VMs

config MAX_VCPU_PER_VM
	int "Maximum number of vcpu a vm possese"
	range 1 4
	default 1
	help
	  Maximum number of vcpu a vm possese

#config ZVM_HW_SYSTEM_INFO_INIT_PRIORITY
#	int "ZVM hardware system info init priority"
#	default	75
#	help
#		ZVM hardware system init initialization priority.
#		System hardware info must init before ZVM init.

config ZVM_INIT_PRIORITY
	int "ZVM init priority"
	default	80
	help
	  ZVM module initialization priority.

config ZVM_DEBUG_LOG_INFO
	bool "Show system boot info"
	help
		When code level debug is not suitable for
		the this system, we can use log_info to locate
		the boot issue.

config ZVM_TIME_MEASURE
	bool "ZVM measure system latency"
	help
	  ZVM latency measure tools.

config ZVM_ELF_LOADER
	bool "ZVM load elf image for vm"
	help
	  For pharse elf header, and load elf vm image

config ZVM_EARLYPRINT_MSG
	bool "ZVM's early consolo for printing system boot message."
	default n
	help
	  For debug hardware system, there must be a early printk mechanism to
	  output the system info, which is usefull for development.

config DTB_FILE_INPUT
	bool "ZVM system pharse dtb file for os like linux"
	help
	  ZVM pharse dtb file, and get mem partition for vm_mem domain.

config VM_DYNAMIC_MEMORY
	bool "ZVM's allocate dynamic memory space for vm."
	default n
	help
	  ZVM uses dynamic memory allocate mechanism to reduce the memory allocate, 
	  but it will add some time cost.

endif   # ZVM
```

## subsys/virtualization/vdev/Kconfig
```kconfig
# Copyright 2023 HNU-ESNL
# Copyright 2023 openEuler SIG-Zephyr
#
# SPDX-License-Identifier: Apache-2.0

# Now, we init each device for vm, and each device is
# described by dts file, and bind to aliases.
menuconfig ZVM_DEVICE_SUPPORT
	bool "Zephyr Based Virtualization device menu"
	default y
	help
	  	Zephyr device virtualization support.

config VIRT_DEVICE_INTERRUPT_DRIVEN
	bool "Virt device interrupt flag"
	default y
	help
		When VM devices need interrupts, this option must be
		chosen for set callback function.

config VM_VGICV3
	bool "VM gicv3 device that get from vm."
	help
	  	This option is used for building serial1 that get from overlay.

if VM_VGICV3

config VM_VGICV3_INIT_PRIORITY
	int "VM virtio mmio init priority."
	default 52
	help
		When virtio is init, it judge the initialization priority in POST_KERNLE.

endif

config VM_SERIAL1
	bool "VM serial1 that get from vm."
	help
	  	This option is used for building serial1 that get from overlay.

config VM_SERIAL2
	bool "VM serial2 that support vm."
	help
	  	This option is used for building serial2 that get from overlay.

config VM_VIRTIO_MMIO
	bool "virtio_mmio"
	help
		This option is selected by any subsystem which implements the virtio
	  	mmio.

config VM_VIRTIO_BLOCK
	bool "VM virtio_mmio block for vm."
	help
		This option is selected by any subsystem which implements the virtio_block
		using virtio_mmio.

if VM_VIRTIO_MMIO

config VIRTIO_INTERRUPT_DRIVEN
	bool "VM virtio interrupt driver."
	default y
	help
		Enable it if system need virtio mmio interrupt.

config VIRTIO_MMIO_INIT_PRIORITY
	int "VM virtio mmio init priority."
	default 60
	help
		When virtio is init, it judge the initialization priority in POST_KERNLE.

endif

config VM_FIQ_DEBUGGER
	bool "Linux VM debugger console on rk3568."
	help
		When booting linux VM on rk3568, a debugger console must be inited,
		this option is used to map irq to linux vm.

if VM_FIQ_DEBUGGER

config VM_FIQ_DEBUGGER_INIT_PRIORITY
	int "VM fiq debugger init priority."
	default 62
	help
		When fiq debugger is init, it judge the initialization priority in POST_KERNLE.

endif

config VM_CLOCK_SYSTEM_CONTROLLER
	bool "VM clock system controller."
	help
		Some VMs may need to access clock syscon device, which is not suitable
		to passthrough. ZVM must manager these clock devices and determining which
		devices can be accessed.

if VM_CLOCK_SYSTEM_CONTROLLER

config VM_CLOCK_SYSTEM_CONTROLLER_INIT_PRIORITY
	int "VM system clock controller init priority."
	default 58
	help
		When virt system clock is init, it judge the initialization priority in POST_KERNLE.

endif

config VM_SYSCON_CONTROLLER
	bool "VM syscon controller."
	help
		For hardware board, the system register may be configuration to multiple modes.
		VM which needs these system configurations may access syscon, ZVM must manager
		these configuration and determining which io function can be edit.

if VM_SYSCON_CONTROLLER

config VM_SYSCON_CONTROLLER_INIT_PRIORITY
	int "VM syscon controller init priority."
	default 60
	help
		When virt syscon is init, it judge the initialization priority in POST_KERNLE.

endif

config VM_PCI_BUS_CONTROLLER
	bool "VM pci bus controller."
	help
		PCI bus controller is a bus device that can support mutiple pci device.

if VM_PCI_BUS_CONTROLLER

config VM_PCI_BUS_INIT_PRIORITY
	int "VM pci bus init priority."
	default 68
	help
		PCI bus can be initialized in lowest priority of POST_KERNLE.

endif

config VM_SHMEM
	bool "VM MEM that get from vm."
	help
	  	This option is used for building memory that get from overlay.

if VM_SHMEM

config MEM_INIT_PRIORITY
	int "VM virt mem init priority."
	default 59
	help
		When virtmem is init, it judge the initialization priority in POST_KERNLE.

endif

config VM_SHMEMRW
	bool "VM MEMRW that get from vm."
	help
	  	This option is used for building memory that get from overlay.

if VM_SHMEMRW

config MEMRW_INIT_PRIORITY
	int "VM virt memrw init priority."
	default 60
	help
		When virtmem is init, it judge the initialization priority in POST_KERNLE.

endif
```
